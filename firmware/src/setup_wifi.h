#pragma once
#include <WiFi.h>
#include <WebServer.h>
#include <esp_system.h>
#if __has_include("wifi_secrets.h")
#include "wifi_secrets.h"
#else
#include "wifi_secrets.example.h"
#endif
#include "web_assets.h"   // generated by pack_web.py: deck, calibration page, manifest, icons

// Network I/O runs on core 0. Only the Arduino loop owns the PCA boards, command
// state and watchdog, so a slow HTTP client can never block servo shutdown.
void execute(const char*);
bool outputsOn();
extern bool heartbeatAllowed;
struct SetupReply {
 bool capture=false;
 String text;
 template<class... T> void printf(const char* format,T... args){
  char b[512];snprintf(b,sizeof(b),format,args...);
  if(capture)text+=b;else Serial.print(b);
 }
 void println(const char* s){printf("%s\n",s);}
} reply;
struct NetRequest {uint32_t id,sequence,deadline;bool claim;char token[33],command[192];};
struct NetReply {uint32_t id;int code;char body[768];};
QueueHandle_t requestQueue=nullptr,responseQueue=nullptr;
WebServer setupServer(80);
char netToken[33]={0};uint32_t netSequence=0;bool wifiOwnsMotion=false;
NetReply lastNetReply={};   // replayed when the phone retries the same sequence number

bool readOnlyCommand(const char* c){return !strcmp(c,"STATE")||!strcmp(c,"STATUS")||!strcmp(c,"CAPS")||!strcmp(c,"CALDATA")||!strcmp(c,"GSTATUS")||!strcmp(c,"GPARAM");}
bool safeCommand(const char* c){return readOnlyCommand(c)||!strcmp(c,"OFF")||!strcmp(c,"GSTOP");}
void runOwned(const char* c,bool fromWifi){
 const bool wasOn=outputsOn();
 heartbeatAllowed=!wasOn||wifiOwnsMotion==fromWifi;   // a non-owner poll must not keep the owner's motion alive
 execute(c);
 heartbeatAllowed=true;
 if(!wasOn&&outputsOn())wifiOwnsMotion=fromWifi;
}
void executeSerial(const char* c){
 if(outputsOn()&&wifiOwnsMotion&&!safeCommand(c)){reply.println("ERR Wi-Fi owns motion; OFF first");return;}
 runOwned(c,false);
}
void setupWifiPoll(){
 if(!requestQueue)return;
 NetRequest q;if(xQueueReceive(requestQueue,&q,0)!=pdTRUE)return;
 NetReply r={};r.id=q.id;r.code=200;
 if(int32_t(millis()-q.deadline)>=0){r.code=408;strcpy(r.body,"ERR expired request");}
 else if(q.claim){
  if(outputsOn()&&wifiOwnsMotion){r.code=409;strcpy(r.body,"ERR another phone is driving; wait 1 s or send OFF there");}
  else if(outputsOn()){r.code=409;strcpy(r.body,"ERR USB console owns motion; OFF there first");}
  else {strcpy(netToken,q.token);netSequence=0;lastNetReply={};strcpy(r.body,netToken);}
 }else if(!netToken[0]||strcmp(q.token,netToken)){r.code=403;strcpy(r.body,"ERR session expired; reconnect");}
 else if(q.sequence==netSequence&&lastNetReply.code){r=lastNetReply;r.id=q.id;}   // retry of a command that already ran
 else if(q.sequence<netSequence){r.code=409;strcpy(r.body,"ERR stale command");}
 else {
  netSequence=q.sequence;
  if(outputsOn()&&!wifiOwnsMotion&&!safeCommand(q.command)){r.code=409;strcpy(r.body,"ERR USB owns motion; OFF first");}
  else{
   reply.text="";reply.capture=true;runOwned(q.command,true);reply.capture=false;
   snprintf(r.body,sizeof(r.body),"%s",reply.text.c_str());reply.text="";
  }
  lastNetReply=r;
 }
 xQueueSend(responseQueue,&r,0);
}
bool networkAllowed(){
 const String origin=setupServer.header("Origin");
 if(setupServer.hostHeader()!="192.168.4.1"||
    (origin.length()&&origin!="http://192.168.4.1")||
    setupServer.header("X-Hexapod")!="control-v6"){
  setupServer.send(403,"text/plain","ERR origin/header rejected; reload the page from http://192.168.4.1");return false;
 }
 return true;
}
void dispatchNetwork(NetRequest& q){
 static uint32_t id=0;q.id=++id;q.deadline=millis()+300;
 if(xQueueSend(requestQueue,&q,0)!=pdTRUE){setupServer.send(503,"text/plain","ERR busy");return;}
 NetReply r;uint32_t until=millis()+450;
 while(int32_t(millis()-until)<0){
  if(xQueueReceive(responseQueue,&r,pdMS_TO_TICKS(20))==pdTRUE&&r.id==q.id){
   setupServer.sendHeader("Cache-Control","no-store");setupServer.send(r.code,"text/plain",r.body);return;
  }
 }
 setupServer.send(503,"text/plain","ERR controller timeout");
}
void sendAsset(const char* type,const uint8_t* data,size_t len,bool gz,const char* cache){
 if(gz)setupServer.sendHeader("Content-Encoding","gzip");
 setupServer.sendHeader("Cache-Control",cache);
 setupServer.send_P(200,type,reinterpret_cast<const char*>(data),len);
}
void setupWifiBegin(){
 requestQueue=xQueueCreate(2,sizeof(NetRequest));responseQueue=xQueueCreate(2,sizeof(NetReply));
 if(!requestQueue||!responseQueue){Serial.println("Wi-Fi queue allocation failed; USB available");return;}
 WiFi.mode(WIFI_AP);
 WiFi.softAPConfig(IPAddress(192,168,4,1),IPAddress(192,168,4,1),IPAddress(255,255,255,0));
 if(!WiFi.softAP(HEXAPOD_AP_SSID,HEXAPOD_AP_PASSWORD)){Serial.println("Wi-Fi AP failed; USB available");return;}
 WiFi.setSleep(false);   // lower, steadier latency for joystick traffic
 const char* headers[]={"Origin","X-Hexapod","X-Session"};setupServer.collectHeaders(headers,3);
 setupServer.on("/",HTTP_GET,[]{sendAsset("text/html",DECK_PAGE,sizeof(DECK_PAGE),true,"no-store");});
 setupServer.on("/calibration",HTTP_GET,[]{setupServer.sendHeader("Location","/calibration/");setupServer.send(302,"text/plain","");});
 setupServer.on("/calibration/",HTTP_GET,[]{sendAsset("text/html",CALIBRATION_PAGE,sizeof(CALIBRATION_PAGE),true,"no-store");});
 setupServer.on("/manifest.webmanifest",HTTP_GET,[]{sendAsset("application/manifest+json",MANIFEST_JSON,sizeof(MANIFEST_JSON),true,"no-cache");});
 setupServer.on("/icon-192.png",HTTP_GET,[]{sendAsset("image/png",ICON_192,sizeof(ICON_192),false,"max-age=86400");});
 setupServer.on("/icon-512.png",HTTP_GET,[]{sendAsset("image/png",ICON_512,sizeof(ICON_512),false,"max-age=86400");});
 setupServer.on("/apple-touch-icon.png",HTTP_GET,[]{sendAsset("image/png",ICON_180,sizeof(ICON_180),false,"max-age=86400");});
 setupServer.on("/api/session",HTTP_POST,[]{
  if(!networkAllowed())return;
  NetRequest q={};q.claim=true;
  snprintf(q.token,sizeof(q.token),"%08x%08x%08x%08x",esp_random(),esp_random(),esp_random(),esp_random());
  dispatchNetwork(q);
 });
 setupServer.on("/api/command",HTTP_POST,[]{
  if(!networkAllowed())return;
  const String body=setupServer.arg("plain"),token=setupServer.header("X-Session");
  const int split=body.indexOf('\n');char* end=nullptr;
  if(split<1||split>10||body.length()>203||token.length()!=32){setupServer.send(400,"text/plain","ERR malformed");return;}
  String sequence=body.substring(0,split),command=body.substring(split+1);
  for(unsigned i=0;i<sequence.length();++i)if(sequence[i]<'0'||sequence[i]>'9'){setupServer.send(400,"text/plain","ERR sequence");return;}
  unsigned long number=strtoul(sequence.c_str(),&end,10);
  if(!number||*end||command.length()==0||command.length()>=192){setupServer.send(400,"text/plain","ERR malformed");return;}
  for(unsigned i=0;i<command.length();++i)if(command[i]<32||command[i]>126){setupServer.send(400,"text/plain","ERR malformed");return;}
  NetRequest q={};q.sequence=number;strcpy(q.token,token.c_str());strcpy(q.command,command.c_str());dispatchNetwork(q);
 });
 setupServer.onNotFound([]{setupServer.send(404,"text/plain","Not found");});
 setupServer.begin();
 xTaskCreatePinnedToCore([](void*){for(;;){setupServer.handleClient();vTaskDelay(pdMS_TO_TICKS(2));}},"hexapod-http",8192,nullptr,1,nullptr,0);
 Serial.println("Wi-Fi: Hexapod-Control | http://192.168.4.1 | outputs remain off");
}
